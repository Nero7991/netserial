## Kconfig
```kconfig
menu "netserial"
    config NETSERIAL_RING_SIZE
        int "Output ring size (bytes)"
        default 8192
        range 1024 65536
        help
            Must be a power of two (1024, 2048, ... 65536); the build fails otherwise.
            Output held until the host acknowledges it. When full, new output is dropped and
            counted; the oldest (for example the boot log) is kept.
    config NETSERIAL_FLUSH_MS
        int "Send interval (ms)"
        default 1000
        range 10 60000
        help
            Output is batched and sent at this interval so a power-saving radio is not kept awake.
            An error-level log line is sent immediately.
    config NETSERIAL_RESEND_MS
        int "Resend after no ACK progress (ms)"
        default 2000
        range 100 60000
    config NETSERIAL_PORT
        int "UDP port (device side)"
        default 5514
        range 1 65535
    config NETSERIAL_DEFAULT_HOST
        string "Default host IPv4 address"
        default ""
        help
            Stream here from boot, before any host says HELLO. Empty: hold output until a host
            sends HELLO.
    config NETSERIAL_ACK_MODE
        bool "Keep output until the host ACKs it"
        default y
        help
            Off: output is committed once sendto() succeeds (less airtime, loss in flight is
            reported by the host as a gap but not recovered).
    config NETSERIAL_LAST_WORDS_SIZE
        int "Last-words recorder size (bytes, 0 = off)"
        default 2048
        range 0 16384
        help
            The newest output is also kept in a small circular buffer in RAM that survives a
            software, panic or watchdog reset. After such a reset the next boot replays the newest
            whole lines into the stream, between marker lines, so the output just before a crash
            is not lost even if it never reached the host (or the ring was full and dropping).
            Costs this much RAM. Not kept across power-on or brownout resets.
endmenu
```

## examples/basic/main/Kconfig.projbuild
```kconfig
menu "netserial example"
    config EXAMPLE_WIFI_SSID
        string "Wi-Fi SSID"
        default ""
    config EXAMPLE_WIFI_PASSWORD
        string "Wi-Fi password"
        default ""
endmenu
```
